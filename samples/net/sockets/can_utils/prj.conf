## CMakeLists.txt
```
# SPDX-License-Identifier: Apache-2.0

cmake_minimum_required(VERSION 3.13.1)

include($ENV{ZEPHYR_BASE}/cmake/app/boilerplate.cmake NO_POLICY_SCOPE)
project(can_utils)

target_sources(app PRIVATE src/main.c)
```

## sample.yaml
```
# Copyright (c) 2021 Intel Corporation
#
# SPDX-License-Identifier: Apache-2.0

common:
  tags: can utils CAN
  depends_on: socket can
sample:
  description: CAN utils apis test
  name: CAN utils example
tests:
  sample.net.can.utils:
    platform_whitelist: intel_ehl_crb
```

## prj.conf
```kconfig
CONFIG_CAN=y
CONFIG_CAN_SEDI=y
CONFIG_CAN_UTILS=y
CONFIG_NETWORKING=y
CONFIG_NET_SOCKETS=y
CONFIG_NET_SOCKETS_CAN=y
CONFIG_NET_L2_CANBUS_RAW=y
CONFIG_NET_SOCKETS_POSIX_NAMES=y
CONFIG_NET_SOCKETS_CAN_RECEIVERS=30
CONFIG_IDLE_STACK_SIZE=4096
CONFIG_MAIN_STACK_SIZE=8192

CONFIG_NET_IPV6=n
CONFIG_NET_IPV4=n
CONFIG_NET_MGMT=n
CONFIG_NET_TCP=n
CONFIG_NET_UDP=n

CONFIG_NET_DEFAULT_IF_CANBUS_RAW=y

CONFIG_NET_PKT_RX_COUNT=30
CONFIG_NET_PKT_TX_COUNT=30
CONFIG_NET_BUF_RX_COUNT=30
CONFIG_NET_BUF_TX_COUNT=30

CONFIG_TEST_RANDOM_GENERATOR=y

CONFIG_NET_SHELL=n

CONFIG_LOG=y
# CONFIG_NET_LOG=y

# CONFIG_NET_SOCKETS_LOG_LEVEL_DBG=y
# CONFIG_CAN_LOG_LEVEL_DBG=y

# Use smaller buffers for net_buf as CANBUS packets are quite small.
CONFIG_NET_BUF_DATA_SIZE=128
CONFIG_NET_BUF_USER_DATA_SIZE=0

# To Enable FD mode update yes
CONFIG_CAN_HAS_CANFD=n
CONFIG_NET_SOCKETS_CAN_FD=n

CONFIG_NET_SOCKETS_CAN_ERR_FILTER=y
CONFIG_USERSPACE=y

CONFIG_CAN_UTILS_DEBUG=y
CONFIG_LIB_DEBUG_ENABLE=y
CONFIG_LOG_BUFFER_SIZE=2048
CONFIG_LOG_DEFAULT_LEVEL=4
```

## boards/intel_ehl_crb.conf
```kconfig
CONFIG_ASSERT=y
CONFIG_CAN=y
CONFIG_CAN_SEDI=y
```

## src/main.c
```c
/*
 * Copyright (c) 2021 Intel Corporation.
 *
 * SPDX-License-Identifier: Apache-2.0
 */

#include <logging/log.h>
#include <zephyr.h>
#include <net/socket.h>
#include <net/socket_can.h>
#include <canutils_if.h>

/*
 * @brief can_baud_rate enum
 * List of supported bit rates of PSE CAN
 */
enum can_baud_rates_t {
	CAN_BAUDRATE_20_KBPS    = 20000U,
	CAN_BAUDRATE_50_KBPS    = 50000U,
	CAN_BAUDRATE_100_KBPS   = 100000U,
	CAN_BAUDRATE_125_KBPS   = 125000U,
	CAN_BAUDRATE_250_KBPS   = 250000U,
	CAN_BAUDRATE_500_KBPS   = 500000U,
	CAN_BAUDRATE_800_KBPS   = 800000U,
	CAN_BAUDRATE_1_MBPS     = 1000000U,
	CAN_BAUDRATE_2_MBPS     = 2000000U,
};

/*
 * CAN UTILS Test
 * Test set 1 --->cansend api
 * Test set 2---->candump api
 */
#define CANTEST 5
#define CAN_TEST_DEFAULT_DATA_RATE (500000)

void main(void)
{
	const struct device *can_dev = NULL;

	/* ----Test Set1-----*/
#if CANTEST < 5
	int count = 2;
	char *test_vect[2];
#endif

	can_dev = device_get_binding("CAN_SEDI_0");
	if (!can_dev) {
		printk("Failed to get CAN device 0\n");
		return;
	}

	can_set_mode(can_dev, CAN_NORMAL_MODE);
	can_set_bitrate(can_dev, CAN_BAUDRATE_500_KBPS, CAN_BAUDRATE_500_KBPS);

	can_dev = device_get_binding("CAN_SEDI_1");
	if (!can_dev) {
		printk("Failed to get CAN device 1\n");
		return;
	}

	can_set_mode(can_dev, CAN_NORMAL_MODE);
	can_set_bitrate(can_dev, CAN_BAUDRATE_500_KBPS, CAN_BAUDRATE_500_KBPS);

/* cansend test EXT frame */
#if CANTEST == 1
	test_vect[0] = "can0";
	test_vect[1] = "12345678#1122334455667788";
	printk("\nCANTEST1\n");
	cansend(count, (char **)&test_vect);
/* cansend test FD */
#elif CANTEST == 2
	test_vect[0] = "can0";
	/* <can_id>##<flags>{data} */
	test_vect[1] = "014##0.1122.33445566778811223344";
	printk("\nCANTEST2\n");
	cansend(count, (char **)&test_vect);
/* cansend test remote */
#elif CANTEST == 3
	test_vect[0] = "can0";
	test_vect[1] = "005#R2";
	printk("\nCANTEST3\n");
	cansend(count, (char **)&test_vect);
/* cansend test STD frame */
#elif CANTEST == 4
	test_vect[0] = "can0";
	test_vect[1] = "123#11223344";
	printk("\nCANTEST4\n");
	cansend(count, (char **)&test_vect);
/* ----Test Set2---- */
#elif CANTEST == 5
	printk("\nCANTEST5\n");
	/* candump test STD+EXT frames */
	candump(5, "can0", "-n=25", "-b=can1", "-r=2047~2052", "-f=Y");
#elif CANTEST == 6
	printk("\nCANTEST6\n");
	/* candump test error frame enable */
	candump(3, "can0", "-b=can1", "-e=2");
#elif CANTEST == 7
	printk("\nCANTEST7\n");
	/* EXT frames */
	candump(3, "can0", "-n=25", "-r=1048561~1048562");
#elif CANTEST == 8
	printk("\nCANTEST8\n");
	/* STD frames */
	candump(4, "can0", "-b=can1", "-n=25", "-r=1~10");
#else
	printk("Canutils: Unsupported test\n");
/* CANTEST */
#endif
}
```
