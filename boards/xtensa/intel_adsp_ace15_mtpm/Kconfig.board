## boards/xtensa/intel_adsp_ace15_mtpm/Kconfig.board
```kconfig
# Xtensa board configuration

# Copyright (c) 2020 Intel Corporation
# SPDX-License-Identifier: Apache-2.0

config  BOARD_INTEL_ADSP_ACE15_MTPM
	bool "Intel ADSP ACE 1.5 Meteor PCH M"
	depends on SOC_SERIES_INTEL_ACE1X

config  BOARD_INTEL_ADSP_ACE15_MTPM_SIM
	bool "Intel ADSP ACE 1.5 Meteor PCH M"
	depends on SOC_SERIES_INTEL_ACE1X
```

## boards/xtensa/intel_adsp_ace15_mtpm/Kconfig.defconfig
```kconfig
# Copyright (c) 2020 Intel Corporation
#
# SPDX-License-Identifier: Apache-2.0

if BOARD_INTEL_ADSP_ACE15_MTPM

config BOARD
	default "intel_adsp_ace15_mtpm"

endif # BOARD_INTEL_ADSP_ACE15_MTPM

if BOARD_INTEL_ADSP_ACE15_MTPM_SIM

config BOARD
	default "intel_adsp_ace15_mtpm_sim"

endif # BOARD_INTEL_ADSP_ACE15_MTPM_SIM
```

## drivers/dai/intel/hda/Kconfig.hda
```kconfig
# SOF HDA configuration options

# Copyright (c) 2022 Intel Corporation
# SPDX-License-Identifier: Apache-2.0

DT_COMPAT_INTEL_HDA_DAI := intel,hda-dai

config DAI_INTEL_HDA
	bool "Intel HDA driver for Dai interface"
	default $(dt_compat_enabled,$(DT_COMPAT_INTEL_HDA_DAI))
	select DMA
	help
	  Select this to enable Intel HDA driver.
```

## drivers/espi/Kconfig.xec
```kconfig
# Microchip XEC ESPI configuration options

# Copyright (c) 2019 Intel Corporation
# SPDX-License-Identifier: Apache-2.0

config ESPI_XEC
	bool "XEC Microchip ESPI driver"
	depends on SOC_SERIES_MEC1501X
	help
	  Enable the Microchip XEC ESPI driver for MEC15xx family.

config ESPI_XEC_V2
	bool "XEC Microchip ESPI V2 driver"
	depends on SOC_SERIES_MEC172X
	help
	  Enable the Microchip XEC ESPI driver for MEC172x series.

if ESPI_XEC || ESPI_XEC_V2

config ESPI_OOB_CHANNEL
	default y

config ESPI_FLASH_CHANNEL
	default y

config ESPI_PERIPHERAL_HOST_IO
	default  y

config ESPI_PERIPHERAL_HOST_IO_PVT
	default  y

config ESPI_PERIPHERAL_DEBUG_PORT_80
	default y

config ESPI_PERIPHERAL_UART
	default y

config ESPI_PERIPHERAL_UART_SOC_MAPPING
	int "SoC port exposed as logical eSPI UART"
	default 2 if SOC_SERIES_MEC1501X
	default 1 if SOC_SERIES_MEC172X
	depends on ESPI_PERIPHERAL_UART
	help
	  This tells the driver to which SoC UART to direct the UART traffic
	  send over eSPI from host.

config ESPI_OOB_BUFFER_SIZE
	int "eSPI OOB channel buffer size in bytes"
	default 128
	depends on ESPI_OOB_CHANNEL
	help
	  Use minimum RAM buffer size by default but allow applications to
	  override the value.
	  Maximum OOB payload is 73 bytes.

config ESPI_FLASH_BUFFER_SIZE
	int "eSPI Flash channel buffer size in bytes"
	default 256
	depends on ESPI_FLASH_CHANNEL
	help
	  Use maximum RAM buffer size defined by spec but allow applications
	  to override if eSPI host doesn't support it.

config ESPI_SAF_XEC
	bool "XEC Microchip ESPI SAF driver"
	depends on SOC_SERIES_MEC1501X
	help
	  Enable the Microchip XEC SAF ESPI driver for MEC15xx family.

config ESPI_SAF_XEC_V2
	bool "XEC Microchip ESPI SAF V2 driver"
	depends on SOC_SERIES_MEC172X
	help
	  Enable the Microchip XEC SAF ESPI driver for MEC172x series.

endif #ESPI_XEC
```

## dts/bindings/pwm/microchip,xec-pwm.yaml
```yaml
# Copyright (c) 2019, Intel Corporation
# SPDX-License-Identifier: Apache-2.0

description: Microchip XEC PWM

include: [pwm-controller.yaml, base.yaml]

compatible: "microchip,xec-pwm"

properties:
    reg:
      required: true

    label:
      required: true

    "#pwm-cells":
      const: 1

pwm-cells:
  - channel
```

## samples/subsys/audio/sof/boards/intel_adsp_ace15_mtpm_sim.conf
```kconfig
CONFIG_METEORLAKE=y
CONFIG_INTEL_DMIC=y
CONFIG_INTEL_SSP=y
CONFIG_COMP_SRC=n
CONFIG_IPC_MAJOR_4=y
CONFIG_INTEL_ALH=y
CONFIG_LP_MEMORY_BANKS=1
CONFIG_HP_MEMORY_BANKS=22
CONFIG_RIMAGE_SIGNING_SCHEMA="mtl"
```

## subsys/can_utils/Kconfig
```kconfig
# Kconfig - CANUTILS configuration options
#
# Copyright (c) 2021 Intel Corporation
#
# SPDX-License-Identifier: Apache-2.0
#

menu "Can_utils"

menuconfig CANUTLS
	bool "Enable CAN UTILS feature"
	select CAN_UTILS

config CAN_UTILS
	bool "CAN utils feature"
	select CAN
	select CAN_IOCTL
	select NETWORKING
	select NET_SOCKETS
	select NET_SOCKETS_CAN
	select LOG
	select LOG_IMMEDIATE
	select NET_SOCKETS_CAN_ERR_FILTER
	select CONFIG_NET_SOCKETS_CAN_ERR_FILTER
	select CONFIG_NET_DEFAULT_IF_CANBUS
	help
	  This option enables CAN utils apis.

config CAN_UTILS_DEBUG
	bool "Enable debug logs from can utils"
	help
	  Enable debug logs from can utils

config LIB_DEBUG_ENABLE
	bool "Extended debug for utils lib"
	default n
	help
	  This option enables debug for internal utils lib

endmenu
```

## tests/drivers/spi/spi_loopback/boards/ehl_crb.conf
```kconfig
CONFIG_LOG=y
CONFIG_ASSERT=y
CONFIG_THREAD_STACK_INFO=y
CONFIG_THREAD_MONITOR=y
CONFIG_THREAD_NAME=y
CONFIG_THREAD_RUNTIME_STATS=y
CONFIG_SPI_LOG_LEVEL_DBG=n
CONFIG_SPI_LOOPBACK_DRV_NAME="SPI_PSE_0"
CONFIG_SPI_LOOPBACK_CS_GPIO=n
CONFIG_SPI_ASYNC=n
CONFIG_SPI_LOOPBACK_SLAVE_NUMBER=1
CONFIG_SPI_LOOPBACK_SLOW_FREQ=4000000
CONFIG_SPI_LOOPBACK_FAST_FREQ=4000000
CONFIG_SPI_LOOPBACK_MODE_LOOP=y
CONFIG_SPI_INTEL_USE_DMA=y
```
